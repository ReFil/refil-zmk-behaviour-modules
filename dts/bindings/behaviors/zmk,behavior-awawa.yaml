## dts/bindings/behaviors/zmk,behavior-awawa.yaml
```yaml
# Copyright (c) 2024 The ZMK Contributors
# SPDX-License-Identifier: MIT

description: Keyboard awawa Behavior

compatible: "zmk,behavior-awawa"

include: zero_param.yaml

properties:
  delay_ms:
    type: int
    required: true
```

## dts/bindings/behaviors/zmk,behavior-gpio-action.yaml
```yaml
# Copyright (c) 2024 The ZMK Contributors
# SPDX-License-Identifier: MIT

description: GPIO action behaviour

compatible: "zmk,behavior-gpio-action"

include: one_param.yaml

properties:
  action-gpios:
    type: phandle-array
    required: true
  delay-ms:
    type: int
    required: false
    default: 10
```

## dts/bindings/behaviors/zmk,behavior-keysmash.yaml
```yaml
# Copyright (c) 2024 The ZMK Contributors
# SPDX-License-Identifier: MIT

description: Keyboard Keysmash Behavior

compatible: "zmk,behavior-keysmash"

include: zero_param.yaml

properties:
  delay_ms:
    type: int
    required: true
```

## dts/bindings/behaviors/zmk,behavior-sarcasm.yaml
```yaml
# Copyright (c) 2024 The ZMK Contributors
# SPDX-License-Identifier: MIT

description: SaRcASm BeHaViOr

compatible: "zmk,behavior-sarcasm"

include: zero_param.yaml
```
