/*
 * Copyright (c) 2024 The ZMK Contributors
 *
 * SPDX-License-Identifier: MIT
 */

/ {
    behaviors {
        /omit-if-no-ref/ keysmash: behavior_keysmash {
            compatible = "zmk,behavior-keysmash";
            #binding-cells = <0>;
            delay_ms = <10>;
        };
    };
};