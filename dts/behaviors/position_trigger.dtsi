/*
 * Copyright (c) 2025 The ZMK Contributors
 *
 * SPDX-License-Identifier: MIT
 */

/ {
    behaviors {
        /omit-if-no-ref/ pos_trig: behavior_pos_trig {
            compatible = "zmk,behavior-position-trigger";
            #binding-cells = <1>;
        };
    };
};