## Kconfig
```kconfig
config ZMK_BEHAVIOR_KEY_RELEASE
    bool
    default y
    depends on DT_HAS_ZMK_BEHAVIOR_KEY_RELEASE_ENABLED

if ZMK_BEHAVIOR_KEY_RELEASE

config ZMK_BEHAVIOR_KEY_RELEASE_MAX_HELD
    int "Key Release Max Held"
    help
      Max number of simultaneously held key_releases
    default 10
endif
```

## dts/bindings/behaviors/zmk,behavior-key-release.yaml
```yaml
# Copyright (c) 2020 The ZMK Contributors
# SPDX-License-Identifier: MIT

description: Hold or Tap behavior

compatible: "zmk,behavior-key-release"

include: two_param.yaml

properties:
  bindings:
    type: phandles
    required: true
  press-tap-ms:
    type: int
    default: 5
  release-tap-ms:
    type: int
    default: 5
```

## dts/bindings/behaviors/zmk,behavior-position-trigger.yaml
```yaml
# Copyright (c) 2025 The ZMK Contributors
# SPDX-License-Identifier: MIT

description: Position direct trigger behavior

compatible: "zmk,behavior-position-trigger"

include: one_param.yaml
```

## dts/bindings/behaviors/zmk,behavior-sensor-rotate-pos-trig.yaml
```yaml
# Copyright (c) 2025 The ZMK Contributors
# SPDX-License-Identifier: MIT

description: Sensor rotate position trigger

compatible: "zmk,behavior-sensor-rotate-pos-trig"

properties:
  "#sensor-binding-cells":
    type: int
    required: true
    const: 0
  tap-ms:
    type: int
    default: 5
  pos-inc:
    type: int
    required: true
  pos-dec:
    type: int
    required: true
```
